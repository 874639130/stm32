

#include "includes.h"


#define FLASH_SECTOR_LEN    1024
#define DEVICE_NOMBER_ADDR   0X0800F800  
#define LOCK_REV_LEN         6

#define CMD_MAX_NUM          5
#define LOCK_OFF_LINE_SEND_MAX_NUM 3
#define DEFAULT_CMD                1
#define CHECK_MAX_TIME             20000
TLockCommData LockCommDataBuf[LOCK_NUM];  //全局结构体


unsigned char gCurrentLoopSendIndex=0;
unsigned int  gCheckMaxTime=2;
//TProtocolPort gProtocolPort;
TCommBuf gLockSendData;
const unsigned char Modbus_auchCRCHi[] = 
{ 
0x00, 0xC1, 0x81, 0x40, 0x01, 0xC0, 0x80, 0x41, 0x01, 0xC0, 
0x80, 0x41, 0x00, 0xC1, 0x81, 0x40, 0x01, 0xC0, 0x80, 0x41, 
0x00, 0xC1, 0x81, 0x40, 0x00, 0xC1, 0x81, 0x40, 0x01, 0xC0, 
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0x80, 0x41, 0x00, 0xC1, 0x81, 0x40 
} ; 
/*
*********************************************************************************************************

*********************************************************************************************************
*/
const unsigned char  Modbus_auchCRCLo[] = 
{ 
0x00, 0xC0, 0xC1, 0x01, 0xC3, 0x03, 0x02, 0xC2, 0xC6, 0x06, 
0x07, 0xC7, 0x05, 0xC5, 0xC4, 0x04, 0xCC, 0x0C, 0x0D, 0xCD, 
0x0F, 0xCF, 0xCE, 0x0E, 0x0A, 0xCA, 0xCB, 0x0B, 0xC9, 0x09, 
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0x43, 0x83, 0x41, 0x81, 0x80, 0x40 
};


//typedef void (*TmdSTransactionFun)(TProtocolPort * pProtocolPort); 
unsigned short Modbus_CRC16(unsigned char *puchMsg, unsigned int usDataLen) 
{ 
unsigned char uchCRCHi = 0xFF;
unsigned char uchCRCLo = 0xFF;
unsigned int  uIndex;
 while (usDataLen--)
 { 
  uIndex = uchCRCHi ^ *puchMsg++;
  uchCRCHi = uchCRCLo ^ Modbus_auchCRCHi[uIndex]; 
  uchCRCLo = Modbus_auchCRCLo[uIndex]; 
 } 
 return (uchCRCHi << 8 | uchCRCLo); 
}
/*
*********************************************************************************************************

*********************************************************************************************************
*/
int Modbus_CRCVerify(unsigned char *pBuf,unsigned int Len)
{
  unsigned short TempCRC;
	if(Len<3){return -1;}

	TempCRC=Modbus_CRC16(pBuf,Len-2);
 	if(pBuf[Len-2]!=(unsigned char)(TempCRC>>8))
	{
	 	return -2;
	}

 	if(pBuf[Len-1]!=(unsigned char)(TempCRC&0xff))
	{
	 	return -3;
	}

	return 0;

}

#define NULL 0     



//TLockCommData GetLockCommDataHandle(void)
//{
//  return LockCommDataBuf;
//}


/******************************************************************************************/

/******************************************************************************************/



void Lock_Comm_Data_Buf_Init(void)
{
	unsigned char index;
	for(index=0;index<LOCK_NUM;index++)
	{
		LockCommDataBuf[index].lockNum[0]='0';
		LockCommDataBuf[index].lockNum[1]=index+0x31;
		LockCommDataBuf[index].cmd=DEFAULT_CMD;//
	}
}


static void LOCK_Cmd_Create(TLockCommData *pLock,const UartxPortStru * pRev)
{
	unsigned short crc;
  TLockSendData *pSend=(TLockSendData *)gLockSendData.Buf;
	pSend->lockNum[0]=pLock->lockNum[0];
	pSend->lockNum[1]=pLock->lockNum[1];
	pSend->cmd=pLock->cmd;
	pSend->lockState=pLock->lockState;
	pSend->carState=pLock->carState;
	pSend->batteryState=pLock->batteryState;
	crc=Modbus_CRC16((unsigned char *)pSend,6);
	pSend->crc[0]=crc>>8;
	pSend->crc[1]=crc&0xff;
	gLockSendData.Len=8;
	
	pRev->pSendDataHandle(gLockSendData.Buf,gLockSendData.Len,pRev->port);
}

static void Lock_Comm_Rev_Deal(TLockCommData *pLockComm,const UartxPortStru * pUartxRevData)
{
	TLockRevData *pRev;
	unsigned int time;
	time=OSTimeGet();
  
	
	if(pUartxRevData->revLen==UARTX_FRAM_NULL)return;
	if(pUartxRevData->revLen!=10)return;//
	

	pRev=(TLockRevData *)pUartxRevData->revBuf;
	if(pRev->lockNum[0]!=pLockComm->lockNum[0]||pRev->lockNum[1]!=pLockComm->lockNum[1])
	{
		return;
	}
	pLockComm->lockState=pRev->lockState;
	pLockComm->carState=pRev->carState;
	pLockComm->batteryState=pRev->batteryState;
	
	//已发送给服务器的状态与现有的状态一致就不作为紧急发送了
	if(pLockComm->sendNewState==0)
	{
		if(pLockComm->lockState!=pLockComm->newLockState||pLockComm->carState!=pLockComm->newCarState||pLockComm->batteryState!=pLockComm->newBatteryState)
		{
			pLockComm->newLockState=pLockComm->lockState;
			pLockComm->newCarState=pLockComm->carState;
			pLockComm->newBatteryState=pLockComm->batteryState;
			pLockComm->sendNewState=1;
		}
	}
	//没有接收到新的命令就不再作为紧急发送了
	if(pLockComm->cmd!=DEFAULT_CMD&&pLockComm->cmd==pLockComm->newCmd)
	{
		 pLockComm->revNewCmd=0;
		 pLockComm->cmd=DEFAULT_CMD;
	}
	return;	
}

void Send_Cmd_To_Lock(const UartxPortStru * pRev)//直接由任务调用
{
	unsigned char index;
	//unsigned int osTime;
	for(index=0;index<LOCK_NUM;index++)
	{
	   if(LockCommDataBuf[index].revNewCmd==1)//&&LockCommDataBuf[index].offLine!=1)//收到新的命令马上处理
		 {
			 LockCommDataBuf[index].cmd=LockCommDataBuf[index].newCmd;
			 LOCK_Cmd_Create(&LockCommDataBuf[index],pRev);	
			 Lock_Comm_Rev_Deal(&LockCommDataBuf[index],pRev);
			 break;
		 }
	}
	if(index==LOCK_NUM)
	{
	   LOCK_Cmd_Create(&LockCommDataBuf[gCurrentLoopSendIndex],pRev);
		 Lock_Comm_Rev_Deal(&LockCommDataBuf[gCurrentLoopSendIndex],pRev);
		 gCurrentLoopSendIndex++;
		 gCurrentLoopSendIndex%=LOCK_NUM;
	}
}


